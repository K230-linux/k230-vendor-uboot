## board/canaan/k230_canmv_01studio/Kconfig
```kconfig
if TARGET_K230_CANMV_01STUDIO

config SYS_CPU
	default "k230"
    
config SYS_VENDOR
    default "canaan"

config SYS_BOARD
    default "k230_canmv_01studio"

config SYS_CONFIG_NAME
    default "k230_evb"


config BOARD_SPECIFIC_OPTIONS # dummy
	def_bool y
	select RISCV_THEAD
choice
	prompt "ddr typy freq"
    default CANMV_01STUDIO_LPDDR4_2667

    config CANMV_01STUDIO_LPDDR4_2667
        bool  "canmv 01studio ddr4 2667"
endchoice
endif
```
